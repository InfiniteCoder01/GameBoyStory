#include "00Names.hpp"

namespace Asteroids {
#pragma region ART
const uint8_t PROGMEM tank[] = {
  0x1b, 0xc6, 0x1b, 0xc6, 0x1b, 0xc6, 0xf8, 0x1f, 0xf8, 0x1f, 0xf8, 0x1f,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 0x89
};

const uint8_t PROGMEM asteroid[] = {
  0xf8, 0x1f, 0xf8, 0x1f, 0xf8, 0x1f, 0xf8, 0x1f, 0xf8, 0x1f, 0x4a, 0x69,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 0x1f
};

const uint8_t PROGMEM boom[] = {
  0xf8, 0x1f, 0xf8, 0x1f, 0xf8, 0x1f, 0xf8, 0x1f, 0xf8, 0x1f, 0xf8, 0x1f,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 0x1f
};

const uint8_t PROGMEM base[] = {
  0xf8, 0x1f, 0xf8, 0x1f, 0xf8, 0x1f, 0xf8, 0x1f, 0xf8, 0x1f, 0xf8, 0x1f,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 0x1f
};

const uint8_t PROGMEM baseDamage[] = {
  0xf8, 0x1f, 0xf8, 0x1f, 0xf8, 0x1f, 0xf8, 0x1f, 0xf8, 0x1f, 0xf8, 0x1f,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 0x1f
};

const uint8_t PROGMEM inactivePortal[] = {
  0xf8, 0x1f, 0xf8, 0x1f, 0xf8, 0x1f, 0xf8, 0x1f, 0xf8, 0x1f, 0xf8, 0x1f,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 0x1f
};
#pragma endregion ART

const int MAX_TANK_SPEED = 128, MIN_FIRE_INTERVAL = 70, MAX_ASTEROID_SPEED = 128, MIN_ASTEROID_INTERVAL = 100;
const float BOOM_TIME = 0.25f;

uint16_t spawnRate, asteroidSpeed, tankSpeed, fireRate, score, baseHealth;
float baseDamagedTimer;
Vector<vec2f> bullets, asteroids;
Vector<Pair<vec2i, float>> booms;
vec2f pos, basep;

enum class GameState {
  ASTEROIDS,
  BOSS_FIGHT,
  WIN,
  EXPLORE,
  DEATH
} gameState;

void start();

bool allInPlace() {
  return false;
}

void killAll() {
  for (int j = 0; j < asteroids.size(); j++) booms.push_back(Pair<vec2i, float>(asteroids[j], BOOM_TIME));
  asteroids.clear();
  bullets.clear();
}

float gameOverTimer, winTimer;
void gameOver() {
  gameOverTimer = 1.5f;
  gameState = GameState::DEATH;
  killAll();
}

void update() {
#pragma region Opponents
  static uint32_t spawnTimer;
  baseDamagedTimer = max(baseDamagedTimer - deltaTime, 0.f);
  if (millis() - spawnTimer > spawnRate && (gameState == GameState::ASTEROIDS || gameState == GameState::BOSS_FIGHT)) {
    if (score >= 100 && gameState == GameState::ASTEROIDS) {
      killAll();
      basep = vec2f(random(oled::width - 32), -32);
      gameState = GameState::BOSS_FIGHT;
      spawnRate = 300;
      asteroidSpeed = 40;
    } else {
      asteroids.push_back(vec2f(random(oled::width - 16), -16));
      spawnTimer = millis();
    }
  }

  for (int i = 0; i < asteroids.size(); i++) {
    asteroids[i].y += deltaTime * asteroidSpeed;
    if (asteroids[i].y > oled::height) asteroids.erase(i--);
    else {
      if (pos + 16 > asteroids[i] && pos < asteroids[i] + 16) gameOver();
      for (int j = 0; j < bullets.size(); j++) {
        if (bullets[j] >= asteroids[i] && bullets[j] <= asteroids[i] + 16) {
          score++;
          if (gameState == GameState::ASTEROIDS) {
            fireRate = max(fireRate - 100, MIN_FIRE_INTERVAL);
            tankSpeed = min(tankSpeed + 15, MAX_TANK_SPEED);
            asteroidSpeed = min(asteroidSpeed + 5, MAX_ASTEROID_SPEED);
            spawnRate = max(spawnRate - 100, MIN_ASTEROID_INTERVAL);
          }
          booms.push_back(Pair<vec2i, float>(asteroids[i], BOOM_TIME));
          asteroids.erase(i--);
          bullets.erase(j);
          break;
        }
      }
    }
  }

  if (gameState == GameState::BOSS_FIGHT) {
    static int velX = 20;
    basep.x += velX * deltaTime;
    if (basep.x < 0 || basep.x > oled::width - 32) velX *= -1, basep.x += velX * deltaTime * 2;
    basep.y += deltaTime * 30;
    if (basep.y > oled::height) basep.y = -32;
    if (pos + 16 > basep && pos < basep + 32) gameOver();
  } else if (gameState == GameState::EXPLORE && pos + 16 > basep && pos < basep + 32) {
    // TODO!
  }
#pragma endregion Opponents
#pragma region Player
  static uint32_t bulletTimer;
  static vec2f playerVelocity;
  playerVelocity += ((vec2f)joy * deltaTime * tankSpeed - playerVelocity) * deltaTime * 10.f;
  if (gameState == GameState::ASTEROIDS || gameState == GameState::BOSS_FIGHT || gameState == GameState::EXPLORE) pos.x = constrain(pos.x + playerVelocity.x, 0, oled::width - 16);
  if (gameState == GameState::EXPLORE) pos.y = constrain(pos.y + playerVelocity.y * deltaTime, 0, oled::height - 16);
  if (buttonX.bPressed) bulletTimer = millis() - fireRate - 1;
  if (buttonX.bHeld && (gameState == GameState::ASTEROIDS || gameState == GameState::BOSS_FIGHT) && millis() - bulletTimer > fireRate) {
    bullets.push_back(pos + vec2f(8, 0));
    bulletTimer = millis();
  }
  if (buttonY.bReleased) game = gameSelect;

  for (int i = 0; i < bullets.size(); i++) {
    bullets[i].y -= deltaTime * 70;
    if (bullets[i].y < 0) bullets.erase(i--);
    else if (gameState == GameState::BOSS_FIGHT && bullets[i] >= basep && bullets[i] <= basep + 32) {
      bullets.erase(i--);
      if (allInPlace()) {
        baseHealth--;
        baseDamagedTimer = 0.1;
        if (baseHealth <= 0) gameState = GameState::WIN, winTimer = 1.5f, killAll();
      }
    }
  }
#pragma endregion Player
#pragma region GameOverAndWin
  for (int i = 0; i < booms.size(); i++) {
    booms[i].second -= deltaTime;
    if (booms[i].second < 0) booms.erase(i--);
  }

  if (winTimer > 0) {  // Win Animation
    winTimer = max(winTimer - deltaTime, 0.f);
    if (int((winTimer + deltaTime) * 16) != int(winTimer * 16)) {
      booms.push_back(Pair<vec2i, float>(basep + vec2i(random(32), random(32)) - 8, BOOM_TIME));
    }
    if (winTimer <= 0) gameState = GameState::EXPLORE;
  }
  if (gameOverTimer > 0) {  // Game Over Animation
    gameOverTimer -= deltaTime;
    if (int((gameOverTimer + deltaTime) * 16) != int(gameOverTimer * 16) && gameOverTimer > 0.5) {
      booms.push_back(Pair<vec2i, float>(pos + vec2i(random(16), random(16)) - 8, BOOM_TIME));
    }
    if (gameOverTimer <= 0) return start();
  }
#pragma endregion GameOverAndWin
}

void draw() {
  oled::clear();
  for (auto& bullet : bullets) oled::fillRect(bullet - 1, vec2i(3), WHITE);
  for (auto& pos : asteroids) oled::drawImage(pos, vec2i(16), asteroid, MAGENTA);
  if (gameState == GameState::BOSS_FIGHT || gameState == GameState::EXPLORE) oled::drawImage(basep, vec2i(32), baseDamagedTimer ? baseDamage : base, MAGENTA);
  if (gameState != GameState::DEATH || gameOverTimer > 1) oled::drawImage(pos, vec2i(16, 16), tank, MAGENTA);
  for (auto boomE : booms) oled::drawImage(boomE.first, vec2i(16), boom + 16 * 16 * 2 * (boomE.second < 0.15), MAGENTA);
  oled::setCursor(0, 0);
  oled::println(format("%d", score));
  if (tankSpeed == MAX_TANK_SPEED && asteroidSpeed == MAX_ASTEROID_SPEED && spawnRate == MIN_ASTEROID_INTERVAL && fireRate == MIN_FIRE_INTERVAL) gui::rightText("Death screen!");
}

void start() {
  bullets.clear();
  asteroids.clear();
  booms.clear();
  fireRate = 500;
  spawnRate = 1000;
  asteroidSpeed = 40;
  tankSpeed = 50;
  score = 0;
  gameOverTimer = winTimer = -1;
  baseHealth = 50;
  gameState = GameState::ASTEROIDS;
  pos = vec2f(oled::width / 2.f - 8, oled::height - 16);
  game = Game(update, draw);
}
}
